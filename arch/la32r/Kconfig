## arch/la32r/Kconfig
```kconfig
menu "LA32R architecture"
	depends on LA32R

config SYS_ARCH
	default "la32r"

choice
	prompt "soc select"
	default TARGET_LA32R_LOONGSONSOC_DEMO

config TARGET_LA32R_LOONGSONSOC_DEMO
	bool "LA32R SOC Demo Soc"	

config TARGET_LA32R_BAIXINMEGA_DEMO
    bool "LA32R BAIXIN MEGA Demo SoC"

endchoice

config CPUSTC_L2_CACHE
	bool "CPUSTC unified L2 cache support"
	depends on TARGET_LA32R_LOONGSONSOC_DEMO
	default y
	help
	  Enable selector-2 CACOP maintenance for CPUSTCore implementations
	  with the unified L2 cache. Disable this for L1-only CPUSTCore builds.

config CPUSTC_OHCI_DMA_NO_POST_INVALIDATE
	bool
	depends on TARGET_LA32R_LOONGSONSOC_DEMO
	default y
	help
	  CPUSTC flushes and invalidates OHCI data buffers before DMA and does not
	  access them while the host controller is active. Do not perform the
	  generic post-DMA writeback-invalidate, which is not a pure invalidate.

config LA32R_L1_CACHE_SHIFT
	int
	default "6" if TARGET_LA32R_LOONGSONSOC_DEMO
	default "4"

config LA32R_BOOT_LOGO
	bool "Show a raw RGB565 logo on the VGA framebuffer during startup"
	depends on TARGET_LA32R_LOONGSONSOC_DEMO
	select BOARD_LATE_INIT
	help
	  Copy the built-in 640x480 little-endian RGB565 raw logo to the
	  VGA framebuffer at 0x87e00000 during board_late_init().

config LA32R_BOOT_LOGO_DELAY_MS
	int "Boot logo display time in milliseconds"
	depends on LA32R_BOOT_LOGO
	default 3000
	help
	  Delay before clearing the boot logo and enabling the VGA console.

config SYS_ICACHE_LINE_SIZE
	int
	default "64" if TARGET_LA32R_LOONGSONSOC_DEMO
	default "16"
	help
	  The size of L1 Icache lines, if known at compile time.

config SYS_DCACHE_LINE_SIZE
	int
	default "64" if TARGET_LA32R_LOONGSONSOC_DEMO
	default "16"
	help
	  The size of L1 Dcache lines, if known at compile time.

menu "OS boot interface"

config LA32R_BOOT_FDT
	bool "Hand over a flattened device tree to Linux kernel"
	default y
	help
	  Enable this option if you want U-Boot to hand over a flattened
	  device tree to the kernel. According to UHI register $a0 will be set
	  to -2 and the FDT address is stored in $a1.
endmenu

config SYS_CONFIG_NAME
    string "Config name"
    default "la32rmegasoc_demo" if TARGET_LA32R_BAIXINMEGA_DEMO
	default "la32rsoc_demo" if TARGET_LA32R_LOONGSONSOC_DEMO

config SYS_TEXT_BASE
    hex "Sys text base"
    default 0xa0200000

config LA32R_RELOCATION_TABLE_SIZE
	hex "Relocation table size"
	range 0x100 0x4000
	default "0x4000"
	---help---
	  A table of relocation data will be appended to the U-Boot binary
	  and parsed in relocate_code() to fix up all offsets in the relocated
	  U-Boot.

	  This option allows the amount of space reserved for the table to be
	  adjusted in a range from 256 up to 64k. The default is 32k and should
	  be ok in most cases. Reduce this value to shrink the size of U-Boot
	  binary.

	  The build will fail and a valid size suggested if this is too small.

	  If unsure, leave at the default value.

endmenu
```
